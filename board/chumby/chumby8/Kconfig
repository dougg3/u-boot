## board/chumby/chumby8/Kconfig
```kconfig
if TARGET_CHUMBY8

config SYS_BOARD
	default "chumby8"

config SYS_VENDOR
	default "chumby"

config SYS_SOC
	default "armada100"

config SYS_CONFIG_NAME
	default "chumby8"

endif
```

## configs/chumby8_defconfig
```kconfig
CONFIG_ARM=y
CONFIG_ARCH_CPU_INIT=y
CONFIG_TARGET_CHUMBY8=y
CONFIG_SYS_TEXT_BASE=0x0
CONFIG_NR_DRAM_BANKS=1
CONFIG_ENV_SIZE=0x20000
CONFIG_DEFAULT_DEVICE_TREE="pxa168-chumby8"
CONFIG_IDENT_STRING="\nChumby 8"
CONFIG_BOOTDELAY=3
CONFIG_USE_PREBOOT=y
# CONFIG_CONSOLE_MUX is not set
# CONFIG_DISPLAY_BOARDINFO is not set
CONFIG_BOARD_EARLY_INIT_F=y
CONFIG_CMD_BOOTZ=y
CONFIG_CMD_GPIO=y
CONFIG_CMD_MMC=y
CONFIG_CMD_PART=y
CONFIG_CMD_POWEROFF=y
# CONFIG_CMD_SETEXPR is not set
CONFIG_CMD_BMP=y
CONFIG_CMD_EXT4=y
CONFIG_DOS_PARTITION=y
CONFIG_OF_CONTROL=y
CONFIG_ENV_IS_IN_EXT4=y
CONFIG_ENV_EXT4_INTERFACE="mmc"
CONFIG_ENV_EXT4_DEVICE_AND_PART="0:2"
CONFIG_ENV_EXT4_FILE="/boot/uboot.env"
CONFIG_SYS_RELOC_GD_ENV_ADDR=y
# CONFIG_NET is not set
CONFIG_GPIO_HOG=y
CONFIG_MMC_SDHCI=y
CONFIG_MMC_SDHCI_MV=y
CONFIG_SPECIFY_CONSOLE_INDEX=y
CONFIG_SYS_NS16550=y
CONFIG_DM_VIDEO=y
CONFIG_VIDEO_PCI_DEFAULT_FB_SIZE=0x0
CONFIG_BACKLIGHT_GPIO=y
# CONFIG_CMD_VIDCONSOLE is not set
# CONFIG_VIDEO_BPP8 is not set
# CONFIG_VIDEO_BPP16 is not set
# CONFIG_VIDEO_ANSI is not set
CONFIG_SYS_WHITE_ON_BLACK=y
CONFIG_VIDEO_PXA168=y
CONFIG_BMP_24BPP=y
```
